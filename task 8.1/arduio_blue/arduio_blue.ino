#include <ArduinoBLE.h>

#include <Wire.h>
#include <BH1750.h>

// Must match the UUID in Python code
BLEService lightService("0000fff0-0000-1000-8000-00805f9b34fb");
BLEStringCharacteristic commandChar(
    "0000fff1-0000-1000-8000-00805f9b34fb",
    BLEWrite,
    20
);

const float LIGHT_THRESHOLD = 10.0;

BH1750 lightMeter;


const int BATHROOM_LED = 2;
const int HALLWAY_LED  = 3;
const int FAN_PIN      = 4;

void setup() {
    Serial.begin(9600);

     Wire.begin();
            lightMeter.begin()

    pinMode(BATHROOM_LED, OUTPUT);
    pinMode(HALLWAY_LED,  OUTPUT);
    pinMode(FAN_PIN,      OUTPUT);

    if (!BLE.begin()) {
        Serial.println("BLE failed");
        while (1);
    }

    BLE.setLocalName("ArduinoLights");
    BLE.setAdvertisedService(lightService);
    lightService.addCharacteristic(commandChar);
    BLE.addService(lightService);
    BLE.advertise();

    Serial.println("Arduino BLE ready, waiting for commands...");
}

void loop() {
    BLEDevice central = BLE.central();

    if (central) {
        Serial.print("Connected to: ");
        Serial.println(central.address());

        while (central.connected()) {
            if (commandChar.written()) {
                String cmd = commandChar.value();
                Serial.print("Received: ");
                Serial.println(cmd);
                handleCommand(cmd);
            }
        }
        Serial.println("Disconnected.");
    }
}


bool isRoomDark() {
    float lux = lightMeter.readLightLevel();
    Serial.print("Light level (lux): ");
    Serial.println(lux);
    return lux <= LIGHT_THRESHOLD;
}

void handleCommand(String cmd) {
    if (cmd == "BATHROOM_ON") {
        if (isRoomDark()) { // I ADDED THE IS ROOM DARK LIGHT SENSOR 
            digitalWrite(BATHROOM_LED, HIGH);
            Serial.println("Bathroom light ON");
        } else {
            Serial.println("Bathroom light skipped ");
        }
    } else if (cmd == "HALLWAY_ON") {
        if (isRoomDark()) {             //HERE TOO
            digitalWrite(HALLWAY_LED, HIGH);
            Serial.println("Hallway light ON (room is dark)");
        } else {
            Serial.println("Hallway light skipped ");
        }
    } else if (cmd == "FAN_ON") {
        digitalWrite(FAN_PIN, HIGH);  // fan is not light-dependent
        Serial.println("Fan ON");
    } else if (cmd == "ALL_ON") {
        if (isRoomDark()) {
            digitalWrite(BATHROOM_LED, HIGH);
            digitalWrite(HALLWAY_LED,  HIGH);
            Serial.println("Lights ON");
        } else {
            Serial.println("Lights skipped");
        }
        digitalWrite(FAN_PIN, HIGH);  // fan always turns on regardless
        Serial.println("Fan ON");
    } else if (cmd == "ALL_OFF") {
        digitalWrite(BATHROOM_LED, LOW);
        digitalWrite(HALLWAY_LED,  LOW);
        digitalWrite(FAN_PIN,      LOW);
        Serial.println("All OFF");
    }
}
